## sdkconfig.defaults
```kconfig
# Target
CONFIG_IDF_TARGET="esp32s3"

# CPU frequency (Xtensa LX7 dual-core, up to 240MHz)
CONFIG_ESP_DEFAULT_CPU_FREQ_MHZ_240=y
CONFIG_ESP_DEFAULT_CPU_FREQ_MHZ=240

# Partition table
CONFIG_PARTITION_TABLE_CUSTOM=y
CONFIG_PARTITION_TABLE_CUSTOM_FILENAME="partitions.csv"

# FreeRTOS
CONFIG_FREERTOS_HZ=1000
CONFIG_ESP_MAIN_TASK_STACK_SIZE=32768
CONFIG_FREERTOS_USE_TRACE_FACILITY=n
CONFIG_FREERTOS_GENERATE_RUN_TIME_STATS=n
CONFIG_FREERTOS_NUMBER_OF_CORES=2

# NimBLE (v6.0.1 default BLE stack)
CONFIG_BT_ENABLED=y
CONFIG_BT_NIMBLE_ENABLED=y
CONFIG_BT_NIMBLE_MAX_CONNECTIONS=1

# WiFi power optimization
CONFIG_ESP_WIFI_STATIC_RX_BUFFER_NUM=6
CONFIG_ESP_WIFI_DYNAMIC_RX_BUFFER_NUM=10
CONFIG_ESP_WIFI_DYNAMIC_TX_BUFFER_NUM=6
CONFIG_ESP_WIFI_SOFTAP_SUPPORT=n
CONFIG_ESP_WIFI_ENTERPRISE_SUPPORT=n

# Flash (DIO 80MHz - S3 supports faster flash)
CONFIG_ESPTOOLPY_FLASHSIZE_16MB=y
CONFIG_ESPTOOLPY_FLASHMODE_DIO=y
CONFIG_ESPTOOLPY_FLASHFREQ_80M=y

# PSRAM (8MB octal PSRAM, co-packaged with ESP32-S3)
CONFIG_ESP32S3_SPIRAM_SUPPORT=y
CONFIG_SPIRAM_MODE_OCT=y
CONFIG_SPIRAM_SPEED_80M=y
CONFIG_SPIRAM_MALLOC_ALWAYSINTERNAL=4096

# Log level (WARN = less strings in flash)
CONFIG_LOG_DEFAULT_LEVEL_WARN=y
CONFIG_LOG_DYNAMIC_LEVEL_CONTROL=n

# Compiler optimizations for size
CONFIG_COMPILER_OPTIMIZATION_SIZE=y
CONFIG_COMPILER_OPTIMIZATION_CHECKS_SILENT=y
CONFIG_ESP_ERR_TO_NAME_LOOKUP=n
CONFIG_ESP_SYSTEM_USE_FRAME_POINTER=n

# UART0 Console (GPIO43-TX/44-RX, USB serial chip, 1M baud)
CONFIG_ESP_CONSOLE_UART_CUSTOM=y
CONFIG_ESP_CONSOLE_UART_CUSTOM_NUM_0=y
CONFIG_ESP_CONSOLE_UART_TX_GPIO=43
CONFIG_ESP_CONSOLE_UART_RX_GPIO=44
CONFIG_ESP_CONSOLE_UART_BAUDRATE=1000000
CONFIG_ESPTOOLPY_MONITOR_BAUD=1000000
CONFIG_ESP_CONSOLE_SECONDARY_NONE=y

# Power Management
CONFIG_PM_ENABLE=y
CONFIG_PM_DFS_INIT_AUTO=y

# Light-sleep: manual only (auto causes tick count conflict on S3)
# CONFIG_FREERTOS_USE_TICKLESS_IDLE=y  # DISABLED: causes vTaskStepTick assert
# CONFIG_FREERTOS_IDLE_TIME_BEFORE_SLEEP=3
CONFIG_PM_POWER_DOWN_CPU_IN_LIGHT_SLEEP=n
CONFIG_PM_LIGHTSLEEP_TICK_OVERFLOW_PROTECTION=y
CONFIG_ESP_PHY_MAC_BB_PD=y

# Task WDT: 10s to match TIMEOUT_WDT (code sets via esp_task_wdt_init,
# but if system inits WDT first, this default applies)
CONFIG_ESP_TASK_WDT_TIMEOUT_S=10

# Brownout detection threshold (WiFi TX LDO drop, Level 7 = 2.51V)
CONFIG_ESP_BROWNOUT_DET_LVL_SEL_7=y

# RTC clock: use 8MD256 (8MHz/256=31.25kHz) for better deep-sleep timer accuracy
# (RC_SLOW ~136kHz has +/-40% drift, 8MD256 has +/-5% drift)
CONFIG_RTC_CLK_SRC_INT_8MD256=y
CONFIG_RTC_CLK_CAL_CYCLES=0

# Deep-sleep fast boot - DISABLED (risky: flash corruption won't be detected)
# CONFIG_BOOTLOADER_SKIP_VALIDATE_IN_DEEP_SLEEP=y

# mbedTLS: disable debug + unused features
CONFIG_MBEDTLS_DEBUG_LEVEL=0
CONFIG_MBEDTLS_HAVE_TIME=n
CONFIG_MBEDTLS_SHA512_C=n
CONFIG_MBEDTLS_SSL_RENEGOTIATION=n
CONFIG_MBEDTLS_CCM_C=n
CONFIG_MBEDTLS_GCM_C=n

# lwIP: disable IPv6 (only need IPv4)
CONFIG_LWIP_IPV6=n

# TCP buffer optimization for file download
CONFIG_LWIP_TCP_SND_BUF_DEFAULT=8192
CONFIG_LWIP_TCP_WND_DEFAULT=8192

# Disable floating point printf (reduce stack usage)
CONFIG_LIBC_NEWLIB_NANO_FORMAT=y

# Line ending: LF for both stdout and stdin (Linux compatible)
CONFIG_LIBC_STDOUT_LINE_ENDING_LF=y
CONFIG_LIBC_STDIN_LINE_ENDING_LF=y

# FATFS (FAT32 support)
CONFIG_FATFS_LFN_HEAP=y
CONFIG_FATFS_MAX_LFN=128

# HTTP Server
CONFIG_HTTPD_MAX_REQ_HDR_LEN=512
CONFIG_HTTPD_MAX_URI_LEN=256
```
